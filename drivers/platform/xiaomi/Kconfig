## drivers/platform/xiaomi/Kconfig
```kconfig
# Xiaomi configuration options

config MACH_XIAOMI
	bool "Xiaomi device"
	depends on ARCH_QCOM
	help
	  Support for Xiaomi products

config MACH_XIAOMI_SDM660
	bool "Xiaomi SDM660"
	depends on ARCH_QCOM
	select MACH_XIAOMI
	help
	  Support for Xiaomi SDM660 devices

menu "Xiaomi board selection"

	config MACH_MI
		bool "Mi board"
		select MACH_XIAOMI_SDM660
		help
		  Support for Mi boards

	config MACH_XIAOMI_JASON
		bool "Xiaomi jason board"
		select MACH_MI
		help
		  Support for Xiaomi Mi Note 3

endmenu

source "drivers/platform/xiaomi/jason/Kconfig"
```
